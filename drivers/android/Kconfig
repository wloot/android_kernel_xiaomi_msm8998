## drivers/android/Kconfig
```kconfig
menu "Android"

config ANDROID
	bool "Android Drivers"
	---help---
	  Enable support for various drivers needed on the Android platform

if ANDROID

config ANDROID_BINDER_IPC
	bool "Android Binder IPC Driver"
	depends on MMU && !M68K
	default n
	---help---
	  Binder is used in Android for both communication between processes,
	  and remote method invocation.

	  This means one Android process can call a method/routine in another
	  Android process, using Binder to identify, invoke and pass arguments
	  between said processes.

config ANDROID_BINDER_DEVICES
	string "Android Binder devices"
	depends on ANDROID_BINDER_IPC
	default "binder,hwbinder,vndbinder"
	---help---
	  Default value for the binder.devices parameter.

	  The binder.devices parameter is a comma-separated list of strings
	  that specifies the names of the binder device nodes that will be
	  created. Each binder device has its own context manager, and is
	  therefore logically separated from the other devices.

config ANDROID_BINDER_IPC_SELFTEST
	bool "Android Binder IPC Driver Selftest"
	depends on ANDROID_BINDER_IPC
	---help---
	  This feature allows binder selftest to run.

	  Binder selftest checks the allocation and free of binder buffers
	  exhaustively with combinations of various buffer sizes and
	  alignments.

config ANDROID_SIMPLE_LMK
	bool "Simple Android Low Memory Killer"
	depends on !MEMCG
	---help---
	  This is a complete low memory killer solution for Android that is
	  small and simple. It is integrated deeply into the page allocator to
	  know exactly when a page allocation hits OOM and exactly when a page
	  is freed. Processes are killed according to the priorities that
	  Android gives them, so that the least important processes are always
	  killed first.

if ANDROID_SIMPLE_LMK

config ANDROID_SIMPLE_LMK_MINFREE
	int "Minimum MiB of memory to free per reclaim"
	default "64"
	help
	  Simple LMK will free at least this many MiB of memory per reclaim.

config ANDROID_SIMPLE_LMK_KILL_TIMEOUT
	int "Kill timeout in milliseconds"
	default "20"
	help
	  Simple LMK will only perform memory reclaim at most once per this
	  amount of time.

endif # if ANDROID_SIMPLE_LMK

endif # if ANDROID

endmenu
```

## drivers/clk/msm/mdss/Kconfig
```kconfig
config MSM_MDSS_PLL
	bool "MDSS pll programming"
	depends on COMMON_CLK_MSM
	---help---
	It provides support for DSI, eDP and HDMI interface pll programming on MDSS
	hardware. It also handles the pll specific resources and turn them on/off when
	mdss pll client tries to enable/disable pll clocks.

config MSM_MDSS_PLL_8996
	bool "MSM8996 MDSS pll programming"
	depends on MSM_MDSS_PLL
	default y if ARCH_MSM8996
        ---help---
	Support for the MSM8996 MDSS_PLL

config MSM_MDSS_PLL_8998
        bool "MSM8998 MDSS pll programming"
        depends on MSM_MDSS_PLL
        default y if ARCH_MSM8998
        ---help---
        Support for the MSM8998 MDSS_PLL
```
